/dts-v1/;
/plugin/;

/*
 * Generic FPGA reconfiguration overlay for the DE1-SoC (Cyclone V).
 * Loads /lib/firmware/fpga.rbf into the base FPGA region at runtime.
 *
 * Design-agnostic: it only names the bitstream (fpga.rbf), so it works for ANY
 * self-contained fabric design. For HPS-facing designs (peripherals the HPS
 * drives), add matching child device nodes under __overlay__.
 */

/ {
    fragment@0 {
        target-path = "/soc/base-fpga-region";
        #address-cells = <1>;
        #size-cells = <1>;
        __overlay__ {
            #address-cells = <1>;
            #size-cells = <1>;
            firmware-name = "fpga.rbf";
        };
    };
};
